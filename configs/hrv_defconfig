## configs/hrv_defconfig
```kconfig
# Host
BR2_CCACHE=y
BR2_CCACHE_USE_BASEDIR=n

# Architecture
BR2_riscv=y
BR2_riscv_custom=y
BR2_RISCV_ISA_CUSTOM_RVM=y
BR2_RISCV_ISA_CUSTOM_RVC=y
BR2_RISCV_ABI_LP64D=y
BR2_CCACHE=y
BR2_SSP_STRONG=y
BR2_SSP_OPTION="-fstack-protector-strong"
BR2_HOST_DIR="$(BR2_EXTERNAL)/install"
BR2_CCACHE_DIR="$(BR2_EXTERNAL)/.buildroot-ccache"
BR2_TOOLCHAIN=y
BR2_TOOLCHAIN_USES_GLIBC=y
BR2_TOOLCHAIN_BUILDROOT=y
BR2_TOOLCHAIN_BUILDROOT_GLIBC=y
BR2_PACKAGE_GLIBC=y
BR2_GCC_VERSION_11_X=y
BR2_TOOLCHAIN_BUILDROOT_CXX=y
BR2_PACKAGE_HOST_GDB=y
BR2_PACKAGE_HOST_GDB_TUI=y
BR2_ROOTFS_OVERLAY="$(BR2_EXTERNAL)/rootfs"
BR2_LINUX_KERNEL=y
BR2_LINUX_KERNEL_CUSTOM_VERSION=y
BR2_LINUX_KERNEL_CUSTOM_VERSION_VALUE="5.15.9"
BR2_LINUX_KERNEL_USE_CUSTOM_CONFIG=y
BR2_LINUX_KERNEL_CUSTOM_CONFIG_FILE="$(BR2_EXTERNAL_HERO_PATH)/configs/linux_defconfig"

# Skeleton and BusyBox
BR2_PACKAGE_BUSYBOX=y
BR2_PACKAGE_BUSYBOX_CONFIG="$(BR2_EXTERNAL_HERO_PATH)/configs/busybox_fragment.config"

# Host packages
BR2_PACKAGE_HOST_CMAKE=y
BR2_PACKAGE_HOST_PKGCONF=y

# Local packages
BR2_PACKAGE_HERO_PLATFORM="ARIANE"
BR2_PACKAGE_ARIANE_SUPPORT=y
BR2_PACKAGE_ARIANE_SUPPORT_RANDOM_INIT=y
BR2_PACKAGE_LIBPULP=y
BR2_PACKAGE_PULP_DRIVER=y
BR2_PACKAGE_LIBHERO_TARGET=y
BR2_PACKAGE_HERO_APPS=y
BR2_PACKAGE_HERO_OPENMP=y

# Generic packages
BR2_PACKAGE_NFS_UTILS=y
BR2_PACKAGE_LIBNFS=y
BR2_PACKAGE_IPROUTE2=y
BR2_PACKAGE_DROPBEAR=y
BR2_PACKAGE_IFUPDOWN_SCRIPTS=y
BR2_PACKAGE_BZIP2=y
BR2_PACKAGE_XZ=y
BR2_PACKAGE_DHRYSTONE=y
BR2_PACKAGE_STRACE=y
BR2_PACKAGE_NETPERF=y
BR2_PACKAGE_WHETSTONE=y
BR2_PACKAGE_BINUTILS=y
BR2_PACKAGE_E2FSPROGS=y
BR2_PACKAGE_E2FSPROGS_FSCK=y
BR2_PACKAGE_ZLIB=y
BR2_PACKAGE_LIBZLIB=y
BR2_PACKAGE_OPENSSL=y
BR2_PACKAGE_LIBOPENSSL=y
BR2_PACKAGE_LIBFUSE=y
BR2_PACKAGE_EXPAT=y
BR2_PACKAGE_NSS_MDNS=y
BR2_PACKAGE_LIBDAEMON=y
BR2_PACKAGE_NCURSES=y
BR2_PACKAGE_NCURSES_ADDITIONAL_TERMINFO=""
BR2_PACKAGE_PCRE=y
BR2_PACKAGE_PCRE_UTF=y
BR2_PACKAGE_PCRE_UCP=y
BR2_PACKAGE_POPT=y
BR2_PACKAGE_AVAHI=y
BR2_PACKAGE_AVAHI_AUTOIPD=y
BR2_PACKAGE_AVAHI_DAEMON=y
BR2_PACKAGE_ETHTOOL=y
BR2_PACKAGE_ETHTOOL_PRETTY_PRINT=y
BR2_PACKAGE_RSYNC=y
BR2_PACKAGE_SCREEN=y
BR2_PACKAGE_UTIL_LINUX=y
BR2_PACKAGE_UTIL_LINUX_LIBBLKID=y
BR2_PACKAGE_UTIL_LINUX_LIBMOUNT=y
BR2_PACKAGE_UTIL_LINUX_LIBUUID=y
BR2_PACKAGE_NANO=y
BR2_PACKAGE_NANO_TINY=y
BR2_PACKAGE_UEMACS=y
```

## package/hero-openmp/Config.in
```kconfig
config BR2_PACKAGE_HERO_OPENMP
	bool "LLVM OpenMP offload plugin for HERO accelerators (Snitch/PULP)"
	select BR2_PACKAGE_ELFUTILS
	select BR2_PACKAGE_LIBFFI

choice
	prompt "HERO Device type"
	help
	  Select what device to target for offloading

config BR2_PACKAGE_HERO_OPENMP_DEVICE_PULP
	bool "PULP device"
	select BR2_PACKAGE_LIBPULP

config BR2_PACKAGE_HERO_OPENMP_DEVICE_SNITCH
	bool "Snitch device"
	select BR2_PACKAGE_LIBSNITCH

endchoice
```
